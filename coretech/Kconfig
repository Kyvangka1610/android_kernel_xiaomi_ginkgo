## coretech/Kconfig
```kconfig
config OPCHAIN
	default y
	bool "Oneplus CoreTech helper, used for opchain module"
config DEFRAG
	default y
	bool "anti-defragment feature"
	help
	 anti-defragment feature.
config HOUSTON
	default y
	bool "houston rocket play your temperature guard"
	help
	 Realtime temperature monitor
config MEMPLUS
	default y
	bool "memory+ feature"
	help
	 Memory+ feature
config FSC
	default y
	bool "system layer file status cache"
	help
	 To cache absence file and avoid stat call storm
config SMART_BOOST
	bool "support smart boost feature"
	default y
	help
	 this feature allow memory used by recent-app stay in kernel.
config CONTROL_CENTER
	default y
	bool "control center"
config AIGOV
	default y
	bool "A governor which using ai predicted info as input"
```
